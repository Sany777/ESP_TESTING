## components/device_gpio/Kconfig
```kconfig
menu "IO Configuration"

    config BUT_LEFT_PIN
        int "Pin for UP Button"
        default 40
        help
            Set the GPIO pin number for the UP button.

    config BUT_RIGHT_PIN
        int "Pin for DOWN Button"
        default 42
        help
            Set the GPIO pin number for the DOWN button.

    config BUT_CENTER_PIN
        int "Pin for SET Button"
        default 41
        help
            Set the GPIO pin number for the SET button.

endmenu
```

## components/wifi_service/Kconfig
```kconfig
menu "Network Configuration"

    config WIFI_STA_DEBUG_SSID
        string "WiFi debug SSID"
        default ""
        help
            SSID (network name).

    config WIFI_STA_DEBUG_PASSWORD
        string "WiFi debug password"
        default ""
        help
            WiFi password (WPA or WPA2).

    config WIFI_AP_SSID
        string "WiFi AP SSID"
        default "ESPClock"
        help
            SSID (network name).

    config WIFI_AP_PASSWORD
        string "WiFi AP password"
        default "esp32denver"
        help
            WiFi password (WPA or WPA2).


    config MAX_STA_CONN
        int "Maximal STA connections"
        default 1
        help
            Max number of the STA connects to AP.

    config ESPNOW_ENABLE_LONG_RANGE
        bool "Enable long range"


    config DEFAULT_WIFI_SSID
        string "Wi-Fi SSID"
        default "YourSSID"  # Default SSID
        help
            Set the SSID for the Wi-Fi network.

    config DEFAULT_WIFI_PASSWORD
        string "111111"
        default "YourPassword"  # Default Password
        help
            Set the password for the Wi-Fi network.



endmenu
```
